## config/boards/shields/sophie/Kconfig.defconfig
```kconfig
# Copyright (c) 2022 Andrei Gaevskii
# SPDX-License-Identifier: MIT

if SHIELD_SOPHIE_LEFT

config ZMK_KEYBOARD_NAME
	default "Sophie"

config ZMK_SPLIT_ROLE_CENTRAL
	default y

endif

if SHIELD_SOPHIE_LEFT || SHIELD_SOPHIE_RIGHT

config ZMK_SPLIT
	default y

if ZMK_DISPLAY

config I2C
	default y

config SSD1306
	default y

config SSD1306_REVERSE_MODE
	default y

endif # ZMK_DISPLAY

if LVGL

config LVGL_VDB_SIZE
    int
	default 64

config LVGL_DPI
    int
	default 148

config LVGL_BITS_PER_PIXEL
    int
	default 1

choice LVGL_COLOR_DEPTH
    bool
	default "1-bit"
endchoice

endif # LVGL

endif
```

## config/boards/shields/sophie/Kconfig.shield
```kconfig
# Copyright (c) 2022 Andrei Gaevskii
# SPDX-License-Identifier: MIT

config SHIELD_SOPHIE_LEFT
	def_bool $(shields_list_contains,sophie_left)

config SHIELD_SOPHIE_RIGHT
	def_bool $(shields_list_contains,sophie_right)
```
